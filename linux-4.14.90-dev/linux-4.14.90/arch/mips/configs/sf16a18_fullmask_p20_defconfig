## uboot/board/siflower/sfa18_x10/Kconfig
```kconfig
if TARGET_SFA18_X10

config SYS_BOARD
	default "sfa18_x10"

config SYS_VENDOR
	default "siflower"

config SYS_CONFIG_NAME
	default "sfa18"

endif
```

## uboot/board/siflower/sfa28_a28phy/Kconfig
```kconfig
if TARGET_SFA28_A28PHY

config SYS_BOARD
	default "sfa28_a28phy"

config SYS_VENDOR
	default "siflower"

config SYS_CONFIG_NAME
	default "sfa28"

endif
```

## uboot/board/siflower/sfa28_ac28/Kconfig
```kconfig
if TARGET_SFA28_AC28

config SYS_BOARD
	default "sfa28_ac28"

config SYS_VENDOR
	default "siflower"

config SYS_CONFIG_NAME
	default "sfa28"

endif
```
