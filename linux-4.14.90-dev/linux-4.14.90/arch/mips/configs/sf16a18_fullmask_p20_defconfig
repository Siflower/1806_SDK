## linux-4.14.90-dev/linux-4.14.90/arch/mips/configs/sf16a18_fullmask_p20_defconfig
```kconfig
# CONFIG_BINARY_PRINTF is not set
# CONFIG_DEBUG_CREDENTIALS is not set
# CONFIG_DEBUG_SPINLOCK is not set
# CONFIG_FTRACE is not set
# CONFIG_HWMON is not set
CONFIG_INITRAMFS_COMPRESSION_LZMA=y
# CONFIG_INITRAMFS_COMPRESSION_NONE is not set
CONFIG_INLINE_READ_UNLOCK=y
CONFIG_INLINE_READ_UNLOCK_IRQ=y
CONFIG_INLINE_SPIN_UNLOCK_IRQ=y
CONFIG_INLINE_WRITE_UNLOCK=y
CONFIG_INLINE_WRITE_UNLOCK_IRQ=y
CONFIG_KERNEL_GZIP=y
# CONFIG_KERNEL_LZMA is not set
# CONFIG_MTD_SPLIT_LZMA_FW is not set
# CONFIG_SCHEDSTATS is not set
CONFIG_SCHED_DEBUG=y
# CONFIG_SCHED_INFO is not set
# CONFIG_USB_SUPPORT is not set
# CONFIG_XZ_DEC_ARM is not set
# CONFIG_XZ_DEC_ARMTHUMB is not set
# CONFIG_XZ_DEC_BCJ is not set
# CONFIG_XZ_DEC_IA64 is not set
# CONFIG_XZ_DEC_POWERPC is not set
# CONFIG_XZ_DEC_SPARC is not set
```

## linux-4.14.90-dev/linux-4.14.90/arch/mips/siflower/Kconfig
```kconfig
# SPDX-License-Identifier: GPL-2.0
if SIFLOWER

choice
	prompt "Siflower SoC selection"
	default SOC_SF16A18
	help
	  Select Siflower MIPS SoC type.

	config SOC_SF16A18
		bool "SF16A18"

	config SOC_SF19A28
		bool "SF19A28"

endchoice

if SOC_SF16A18

choice
	prompt "Siflower SoC_SF16A18 selection"
	default SF16A18_MPW0
	help
	  Select FULL_MASK SF16A18 SoC

	config SF16A18_FULL_MASK
		bool "SF16A18_FULL_MASK"

endchoice

if SF16A18_FULL_MASK

config DT_SF16A18_FULLMASK_P20
	bool "Built-in device tree for sf16a18 full mask p20 boards"
	default n
	select BUILTIN_DTB
	help
	  The corresponding DTS file is at
	  arch/mips/boot/dts/sf16a18_fullmask_p20.dts

config DT_SF16A18_FULLMASK_EVB_V5
	bool "Built-in device tree for sf16a18 full mask evb_v5 boards"
	default n
	select BUILTIN_DTB
	help
	  The corresponding DTS file is at
	  arch/mips/boot/dts/sf16a18_fullmask_p20.dts

config DT_SF16A18_FULLMASK_86V
	bool "Built-in device tree for sf16a18 86v boards"
	default n
	select BUILTIN_DTB
	help
	  The corresponding DTS file is at
	  arch/mips/boot/dts/sf16a18_fullmask_86v.dts

config DT_SF16A18_FULLMASK_AC20_SJBY
      bool "Built-in device tree for sf16a18 full mask ac20 boards"
      default n
      select BUILTIN_DTB
      help
      The corresponding DTS file is at
      arch/mips/boot/dts/sf16a18_fullmask_ac20_sjby.dts

config DT_SF16A18_FULLMASK_AC20
      bool "Built-in device tree for sf16a18 full mask ac20 boards"
      default n
      select BUILTIN_DTB
      help
      The corresponding DTS file is at
      arch/mips/boot/dts/sf16a18_fullmask_ac20.dts

config DT_SF16A18_FULLMASK_P10H
      bool "Built-in device tree for sf16a18 full mask p10h boards"
      default n
      select BUILTIN_DTB
      help
      The corresponding DTS file is at
      arch/mips/boot/dts/sf16a18_fullmask_p10h.dts


endif #SF16A18_FULL_MASK

endif #SOC_SF16A18

if SOC_SF19A28

choice
	prompt "Siflower SoC_SF19A28 selection"
	default SF19A28_FULLMASK
	help
	  Select FULL_MASK SF19A28 SoC

	config SF19A28_MPW1
		bool "SF19A28_MPW1"

	config SF19A28_FULLMASK
		bool "SF19A28_FULLMASK"

endchoice

if SF19A28_FULLMASK

config DT_SF19A28_FULLMASK_FPGA
	bool "Built-in device tree for sf19a28 fullmask fpga"
	default n
	select BUILTIN_DTB
	help
	  The corresponding DTS file is at
	  arch/mips/boot/dts/sf19a28_fullmask_fpga.dts

config DT_SF19A28_FULLMASK_EVB
	bool "Built-in device tree for sf19a28 fullmask evb"
	default n
	select BUILTIN_DTB
	help
	  The corresponding DTS file is at
	  arch/mips/boot/dts/sf19a28_fullmask_evb.dts

config DT_SF19A28_FULLMASK_NF
	bool "Built-in device tree for sf19a28 fullmask nf"
	default n
	select BUILTIN_DTB
	help
	  The corresponding DTS file is at
	  arch/mips/boot/dts/sf19a28_fullmask_nf.dts

config DT_SF19A28_FULLMASK_AC28
	bool "Built-in device tree for sf19a28 fullmask ac28"
	default n
	select BUILTIN_DTB
	help
	  The corresponding DTS file is at
	  arch/mips/boot/dts/sf19a28_fullmask_ac28.dts

config DT_SF19A28_FULLMASK_AC28NAND
	bool "Built-in device tree for sf19a28 fullmask ac28 nand"
	default n
	select BUILTIN_DTB
	help
	  The corresponding DTS file is at
	  arch/mips/boot/dts/sf19a28_fullmask_ac28nand.dts

config DT_SF19A28_FULLMASK_AC28CSD
	bool "Built-in device tree for sf19a28 fullmask ac28 csd"
	default n
	select BUILTIN_DTB
	help
	  The corresponding DTS file is at
	  arch/mips/boot/dts/sf19a28_fullmask_ac28csd.dts

config DT_SF19A28_FULLMASK_A28_HWA
	bool "Built-in device tree for sf19a28 fullmask a28 hwa board"
	default n
	select BUILTIN_DTB
	help
	  The corresponding DTS file is at
	  arch/mips/boot/dts/sf19a28_fullmask_a28-hwa.dts

config DT_SF19A28_FULLMASK_REP
	bool "Built-in device tree for sf19a28 fullmask repeater"
	default n
	select BUILTIN_DTB
	help
	  The corresponding DTS file is at
	  arch/mips/boot/dts/sf19a28_fullmask_rep.dts

config DT_SF19A28_FULLMASK_AC28S
	bool "Built-in device tree for sf19a28 fullmask ac28s"
	default n
	select BUILTIN_DTB
	help
	  The corresponding DTS file is at
	  arch/mips/boot/dts/sf19a28_fullmask_ac28s.dts

config DT_SF19A28_FULLMASK_WS_IN
	bool "Built-in device tree for sf19a28 fullmask ws in"
	default n
	select BUILTIN_DTB
	help
	  The corresponding DTS file is at
	  arch/mips/boot/dts/sf19a28_fullmask_ws_in.dts

config DT_SF19A28_FULLMASK_AC28S_CSD
	bool "Built-in device tree for sf19a28 fullmask ac28s csd"
	default n
	select BUILTIN_DTB
	help
	  The corresponding DTS file is at
	  arch/mips/boot/dts/sf19a28_fullmask_ac28s_csd.dts

endif #SF19A28_FULLMASK

if SF19A28_MPW1

config DT_SF19A28_MPW1_AC28
	bool "Built-in device tree for sf19a28 mpw1 ac28"
	default n
	select BUILTIN_DTB
	help
	  The corresponding DTS file is at
	  arch/mips/boot/dts/sf19a28_mpw1_ac28.dts

config DT_SF19A28_MPW1_HWA
	bool "Built-in device tree for sf19a28 mpw1 hwa"
	default n
	select BUILTIN_DTB
	help
	  Add an FDT blob for XLP EVP boards into the kernel.
	  arch/mips/boot/dts/sf19a28_mpw1_hwa.dts

config DT_SF19A28_MPW1_EVB
	bool "Built-in device tree for sf19a28 mpw1 evb"
	default n
	select BUILTIN_DTB
	help
	  The corresponding DTS file is at
	  arch/mips/boot/dts/sf19a28_mpw1_evb.dts

config DT_SF19A28_MPW1_AC22
	bool "Built-in device tree for sf19a28 mpw1 ac22"
	default n
	select BUILTIN_DTB
	help
	  The corresponding DTS file is at
	  arch/mips/boot/dts/sf19a28_mpw1_ac22.dts
endif #SF19A28_MPW1


endif #SOC_SF19A28

config FIRMWARE_SIZE
	int "CORE 1 FIRMWARE SIZE (0-8192 KB)"
	range 0 8192
	default 1024
	help
	  This is the firmware size for core 1. If firmware size is
	  set to zero, core 1 will not be powered up.

config FIRMWARE_LOAD_BASE
	hex "CORE 1 FIRMWARE LOAD PHYSICAL BASE ADDRESS "
	range 0 0x10000000
	default 0x1f00000
	help
	  This is the firmware physical base addr for core 1.

config CORE1_MEM_RES
	bool "CORE 1 MEM RESERVE"
	default n
config SIFLOWER_TIMER_CLKSRC
	bool "Enable SiFlower Timer based clocksource"
	depends on SIFLOWER
	select CLKSRC_SFAX8_TIMER
	select MIPS_EXTERNAL_TIMER
	help
	  This option enables a clocksource driver based on a SiFlower external timer.

	  If you want to enable the CPUFreq, you need to enable
	  this option.

	  If you don't want to enable CPUFreq, you can leave this disabled.

config SF_KERNEL_LITE
	bool "Enable SiFlower lite kernel for 4MB flash"
	default n
	help
	  This config enables 4MB flash optimize for SiFlower kernel
	  configs and drivers. It will disable some module features,
	  and only recommended for p10b.

config SF_IRQ_DEBUG
	bool "Enable calculating irq handle total time for debug."
	default n
	depends on SF16A18_FULL_MASK
	help
	  This config enables calculating the total time used for irq
	  handler to check if it's too long.

endif #SIFLOWER
```

## linux-4.14.90-dev/linux-4.14.90/drivers/mtd/nand/spi/Kconfig
```kconfig
menuconfig MTD_NAND_SPI
	tristate "SPI NAND device Support"
	depends on SPI_MASTER
	select SPI_MEM
	help
	  This is the framework for the SPI NAND device drivers.
```

## linux-4.14.90-dev/linux-4.14.90/drivers/mtd/spi-nand/Kconfig
```kconfig
menuconfig MTD_SPI_NAND
	tristate "SPI NAND device support"
	depends on MTD
	select MTD_NAND
	help
	  This is the framework for the SPI NAND.

if MTD_SPI_NAND

config MTD_SPI_NAND_DEVICES
	tristate "Support for SPI NAND devices"
	default y
	depends on MTD_SPI_NAND
	help
	  Select this option if you require support for SPI NAND devices.

endif # MTD_SPI_NAND
```

## linux-4.14.90-dev/linux-4.14.90/drivers/netlink/Kconfig
```kconfig
#
# Netlink subsystem configuration
#

menu "Netlink support"

config SFAX8_GENL
	tristate "Generic netlink socket"
	help
	  Use generic netlink socket to connect user space and kernel.

config SEND_ERR
	bool "send err to user interface"
    default n
	help
	  Use generic netlink socket to connect user space and kernel.

endmenu
```

## linux-4.14.90-dev/linux-4.14.90/drivers/sfax8_factory_read/Kconfig
```kconfig
config SFAX8_FACTORY_READ
	tristate "vender siflower read factory memory"
	depends on MTD
	default y
```

## openwrt-18.06/package/kernel/sf_switch/src/Kconfig
```kconfig
config NET_VENDOR_SIFLOWER
	tristate "vender siflower switch driver support sfax8"
	help
	  This driver supports the ethernet/switch inside

if NET_VENDOR_SIFLOWER

config  SFAX8_SWITCH
	tristate "sfax8 switch driver"
	help
	  This driver supports the ethernet/switch inside

config SFAX8_PTP
	bool "PTP support"
	depends on (SFAX8_GMAC) && (SFAX8_SWITCH)

config SFAX8_SWITCH_FPGA
	bool "Fpga version"
	depends on (SFAX8_SWITCH)

config SFAX8_SWITCH_VLAN
	bool "vlan config enable"
	depends on (SFAX8_SWITCH)

config SFAX8_SWITCH_API
	bool "api enable"
	depends on (SFAX8_SWITCH)

config SFAX8_SWITCH_DPS
	bool "detect port status"
	depends on (SFAX8_SWITCH_VLAN)

config SFAX8_SWITCH_POWERSAVE
	bool "power save enable"
	depends on (SFAX8_SWITCH_VLAN)

config SFAX8_SWITCH_AGEING
	bool "Ageing mac address"
	depends on (SFAX8_SWITCH)

endif
```

## openwrt-18.06/package/kernel/sfax8-factory-read/src/Kconfig
```kconfig
config SFAX8_FACTORY_READ
	tristate "vender siflower read factory memory"
	default y

#depends on MTD
```

## uboot/arch/mips/mach-sfax8/Kconfig
```kconfig
menu "Siflower SFAX8 platforms"
	depends on MACH_SFAX8

config SYS_SOC
	default "sfax8"

choice
	prompt "SOC select"

config SOC_SFA18_MPW0
	bool "SFA18 mpw0 soc"
	help
	  This supports Siflower sfa18 mpw0 SOC.

config SOC_SFA18_MPW1
	bool "SFA18 mpw1 soc"
	help
	  This supports Siflower sfa18 mpw1 SOC.

config SOC_SFA18_FULLMASK
	bool "SFA18 fullmask soc"
	help
	  This supports Siflower sfa18 full mask SOC.

config SOC_SFA28_MPW0
	bool "SFA28 mpw0 soc"
	help
	  This supports Siflower sfa28 mpw0 SOC.

config SOC_SFA28_FULLMASK
	bool "SFA28 fullmask soc"
	help
	  This supports Siflower sfa28 fullmask SOC.
endchoice

choice
	prompt "Board select"

config TARGET_SFA18_P20B
	bool "SFA18 p20b board"

config TARGET_SFA18_P10M
	bool "SFA18 p10m board"

config TARGET_SFA18_X10
	bool "SFA18 x10 board"

config TARGET_SFA18_P10H
	bool "SFA18 p10h board"

config TARGET_SFA18_AC20
	bool "SFA18 ac20 gigabit switch board"

config TARGET_SFA18_P10B
	bool "SFA18 p10b board"

config TARGET_SFA18_86V
	bool "SFA18 86V board"

config TARGET_SFA18_AC
	bool "SFA18 AC board"

config TARGET_SFA18_REP
	bool "SFA18 REP board"

config TARGET_SFA18_AIR001
	bool "SFA18 air001 board"

config TARGET_SFA28_FPGA
	bool "SFA28 FPGA board"

config TARGET_SFA28_P20B
	bool "SFA28 evb board"

config TARGET_SFA28_AC28
	bool "SFA28 ac28 board"

config TARGET_SFA28_A28PHY
	bool "SFA28 a28phy board"

config TARGET_SFA28_REP
	bool "SFA28 rep board"

endchoice

source "board/siflower/sfax8_common/Kconfig"
source "arch/mips/mach-sfax8/pcba-test/Kconfig"

endmenu
```

## uboot/arch/mips/mach-sfax8/pcba-test/Kconfig
```kconfig
menu "PCBA TESTS"
        depends on SFA18_PCBA_TEST

config SFAX8_GDU_TEST
	bool "GDU test"
	help
	  GDU pcba test.

config SFAX8_AUDIO_TEST
	bool "AUDIO TEST"
	help
	  Audio pcba test.

if SFAX8_AUDIO_TEST
	source "arch/mips/mach-sfax8/pcba-test/audio/Kconfig"
endif

config SFAX8_PMU_TEST
	bool "PMU TEST"
	default y
	help
	  PMU pcba test.

if SFAX8_PMU_TEST
	source "arch/mips/mach-sfax8/pcba-test/pmu/Kconfig"
endif

config SFAX8_USB_TEST
	bool "USB TEST"
	help
	  USB pcba test.

config SFAX8_SD_TEST
	bool "SD TEST"
	help
	  sd card pcba test.

config SFAX8_BUTTON_TEST
	bool "BUTTON TEST"
	default y
	help
	  Button pcba test.

config SFAX8_SHARE_MEM_TEST
	bool "SHARE MEMORY TEST"
	default y
	help
	  share memory pcba test.

config SFAX8_GPIO_TEST
	bool "GPIO TEST"
	default y
	help
	  LED pcba test.

config SFAX8_WIFI_TEST
	bool "WIFI TEST"
	default y
	help
	  WIFI pcba test.

config SFAX8_WIFI_EXPA
	bool "WIFI EXPA"
        depends on SFAX8_WIFI_TEST
	default n
	help
	  WIFI use extern PA.

config SFAX8_UPDATE_GAIN_TABLE
    bool "Update tx gain table for EXPA"
        depends on SFAX8_WIFI_EXPA
	default y
	help
	  Update tx gain table for extern PA.

config SFA18_PCBA_STATIC_IP
	bool "static IP addr for WIFI test"
        depends on SFAX8_WIFI_TEST
	default y
	help
	  Use static IP addr 192.168.4.1 for WIFI ITEST device.

config SFAX8_NPU_TEST
	bool "NPU TEST"
        depends on SFA18_ETH
	default y
	help
	  NPU pcba test.

config SFAX8_GMAC_TEST
	bool "GMAC TEST"
        depends on SFA18_GMAC
	default y
	help
	  GMAC pcba test.

endmenu
```

## uboot/arch/mips/mach-sfax8/pcba-test/audio/Kconfig
```kconfig
#
# audio codec configuration.
#
choice

prompt "Audio codec types"

default CODEC_ES8316
help
	There may be many kinds of codec in sfx8 boards, and this
	choice help to select a used codec.

config CODEC_ES8316
	bool "codec es8316"
	help 
		Say Y if the codec type is es8316, else say N.

endchoice
```

## uboot/arch/mips/mach-sfax8/pcba-test/pmu/Kconfig
```kconfig
#
# pmu configuration.
#
choice
prompt "Pmu types"
default PMU_IP6103
help
	There are many kinds of pmu in sfax8 board, and  this
	chioce help to select a used pmu.

config PMU_IP6103
	bool "pmu ip6103"
	help
		Say Y if the pmu type is IP6103, else say N.

config PMU_RN5T567
	bool "pmu rn5t567"
	help
		Say Y if the pmu type is rn5t567, else say N.

endchoice
```

## uboot/board/siflower/sfa18_86v/Kconfig
```kconfig
if TARGET_SFA18_86V

config SYS_BOARD
	default "sfa18_86v"

config SYS_VENDOR
	default "siflower"

config SYS_CONFIG_NAME
	default "sfa18"

endif
```

## uboot/board/siflower/sfa18_ac/Kconfig
```kconfig
if TARGET_SFA18_AC

config SYS_BOARD
	default "sfa18_ac"

config SYS_VENDOR
	default "siflower"

config SYS_CONFIG_NAME
	default "sfa18"

endif
```

## uboot/board/siflower/sfa18_ac20/Kconfig
```kconfig
if TARGET_SFA18_AC20

config SYS_BOARD
	default "sfa18_ac20"

config SYS_VENDOR
	default "siflower"

config SYS_CONFIG_NAME
	default "sfa18"

endif
```

## uboot/board/siflower/sfa18_air001/Kconfig
```kconfig
if TARGET_SFA18_AIR001

config SYS_BOARD
	default "sfa18_air001"

config SYS_VENDOR
	default "siflower"

config SYS_CONFIG_NAME
	default "sfa18"

endif
```

## uboot/board/siflower/sfa18_p10b/Kconfig
```kconfig
if TARGET_SFA18_P10B

config SYS_BOARD
	default "sfa18_p10b"

config SYS_VENDOR
	default "siflower"

config SYS_CONFIG_NAME
	default "sfa18"

endif
```

## uboot/board/siflower/sfa18_p10h/Kconfig
```kconfig
if TARGET_SFA18_P10H

config SYS_BOARD
	default "sfa18_p10h"

config SYS_VENDOR
	default "siflower"

config SYS_CONFIG_NAME
	default "sfa18"

endif
```

## uboot/board/siflower/sfa18_p10m/Kconfig
```kconfig
if TARGET_SFA18_P10M

config SYS_BOARD
	default "sfa18_p10m"

config SYS_VENDOR
	default "siflower"

config SYS_CONFIG_NAME
	default "sfa18"

endif
```

## uboot/board/siflower/sfa18_p20b/Kconfig
```kconfig
if TARGET_SFA18_P20B

config SYS_BOARD
	default "sfa18_p20b"

config SYS_VENDOR
	default "siflower"

config SYS_CONFIG_NAME
	default "sfa18"

endif
```

## uboot/board/siflower/sfa18_rep/Kconfig
```kconfig
if TARGET_SFA18_REP

config SYS_BOARD
	default "sfa18_rep"

config SYS_VENDOR
	default "siflower"

config SYS_CONFIG_NAME
	default "sfa18"

endif
```
