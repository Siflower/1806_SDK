## uboot/board/siflower/sfa28_ac28nand/Kconfig
```kconfig
if TARGET_SFA28_AC28NAND

config SYS_BOARD
	default "sfa28_ac28nand"

config SYS_VENDOR
	default "siflower"

config SYS_CONFIG_NAME
	default "sfa28"

endif
```

## uboot/board/siflower/sfa28_p20b/Kconfig
```kconfig
if TARGET_SFA28_P20B

config SYS_BOARD
	default "sfa28_p20b"

config SYS_VENDOR
	default "siflower"

config SYS_CONFIG_NAME
	default "sfa28"

endif
```

## uboot/board/siflower/sfa28_rep/Kconfig
```kconfig
if TARGET_SFA28_REP

config SYS_BOARD
	default "sfa28_rep"

config SYS_VENDOR
	default "siflower"

config SYS_CONFIG_NAME
	default "sfa28"

endif
```

## uboot/board/siflower/sfax8_common/Kconfig
```kconfig
if MACH_SFAX8

config ETH_LED
	bool "enable npu led in uboot"

config BTN_HTTPD_PMU
	bool "use pmu button to detect if run httpd"
	default n
	help
	  Enable this config to detect if run httpd with pmu button

config BTN_HTTPD_GPIO
	bool "use gpio button to detect if run httpd"
	default n
	help
	  Enable this config to detect if run httpd with gpio button

config BTN_HTTPD_GPIO_VAL
	int "gpio index for enter httpd when uboot booting"
	depends on BTN_HTTPD_GPIO
	default 60
	help
	  gpio index for enter httpd when uboot booting.

choice
	prompt "Siflower gmac mode choise"
	depends on SFA18_GMAC
	default SFA18_RGMII_GMAC
	help
	  Select Siflower GMAC mode.

	config SFA18_RGMII_GMAC
	bool "SFA18  ethernet rgmii mode gmac"

	config SFA18_RMII_GMAC
	bool "SFA18  ethernet rmii mode gmac"

endchoice

config SFAX8_SECURITY_BOOT
	bool "Enable security boot in sfax8 boards"
	select FIT
	select OF_SEPARATE
	select FIT_SIGNATURE
	select RSA
	help
		Select this to enable security boot in sfax8 boards.

config SYS_TEXT_BASE
	default 0xa0000000 if 32BIT
	default 0xffffffffa0000000 if 64BIT

config SYS_MEM_SIZE
	hex "physical ddr size"
	default 0x10000000

config SFA18_UBOOT_LITE
	bool "Siflower SFAX8 uboot lite"
	help
	  Lite version for small flash.

config SFA18_FLASH_SIZE_MB
	int "Siflower SFAX8 flash size"
	default 16
	help
	  Flash size.

config SFA18_PCBA_TEST
	bool "SiFlower PCBA test"
	default n
	help
	  Enable this config to support siflower pcba-test.

if SFA18_PCBA_TEST
choice
	prompt "Siflower wlan choise"
	default SFAX8_WLAN_GMAC if SFA18_GMAC
	default SFAX8_WLAN_NPU if SFA18_ETH
	help
	  Select Siflower wlan port.

	config SFAX8_WLAN_GMAC
	bool "select gmac as wlan port"

	config SFAX8_WLAN_NPU
	bool "select npu as wlan port"

	config SFAX8_DEFAULT_TX_PORT
	int "select npu default tx port"
	depends on SFAX8_WLAN_NPU
	default 4
endchoice
endif
source "board/siflower/sfa18_p20b/Kconfig"
source "board/siflower/sfa18_p10m/Kconfig"
source "board/siflower/sfa18_p10b/Kconfig"
source "board/siflower/sfa18_86v/Kconfig"
source "board/siflower/sfa18_ac/Kconfig"
source "board/siflower/sfa18_x10/Kconfig"
source "board/siflower/sfa18_p10h/Kconfig"
source "board/siflower/sfa18_ac20/Kconfig"
source "board/siflower/sfa18_rep/Kconfig"
source "board/siflower/sfa18_air001/Kconfig"
source "board/siflower/sfa28_fpga/Kconfig"
source "board/siflower/sfa28_p20b/Kconfig"
source "board/siflower/sfa28_ac28/Kconfig"
source "board/siflower/sfa28_a28phy/Kconfig"
source "board/siflower/sfa28_ac28nand/Kconfig"
source "board/siflower/sfa28_rep/Kconfig"

endif
```

## uboot/configs/sfa18_fullmask_p10b_flash_defconfig
```kconfig
CONFIG_MIPS=y
CONFIG_SYS_MALLOC_F_LEN=0x1000
CONFIG_DM_SPI=y
CONFIG_DM_SPI_FLASH=y
CONFIG_DM_GPIO=y
CONFIG_MACH_SFAX8=y
CONFIG_SOC_SFA18_FULLMASK=y
CONFIG_TARGET_SFA18_P10B=y
CONFIG_SYS_MEM_SIZE=0x8000000
CONFIG_SFA18_UBOOT_LITE=y
CONFIG_DEFAULT_DEVICE_TREE="sfa18_fullmask"
CONFIG_SYS_PROMPT="sfa18 # "
# CONFIG_CMD_BDI is not set
# CONFIG_CMD_CONSOLE is not set
# CONFIG_CMD_BOOTD is not set
# CONFIG_CMD_ELF is not set
# CONFIG_CMD_GO is not set
# CONFIG_CMD_RUN is not set
# CONFIG_CMD_IMI is not set
# CONFIG_CMD_IMLS is not set
# CONFIG_CMD_XIMG is not set
# CONFIG_CMD_EXPORTENV is not set
# CONFIG_CMD_IMPORTENV is not set
# CONFIG_CMD_EDITENV is not set
# CONFIG_CMD_SAVEENV is not set
# CONFIG_CMD_ENV_EXISTS is not set
# CONFIG_CMD_MEMORY is not set
# CONFIG_CMD_CRC32 is not set
# CONFIG_CMD_DM is not set
# CONFIG_CMD_LOADB is not set
# CONFIG_CMD_LOADS is not set
# CONFIG_CMD_FLASH is not set
CONFIG_CMD_SF=y
# CONFIG_CMD_FPGA is not set
# CONFIG_CMD_ECHO is not set
# CONFIG_SPL_UPDATE is not set
# CONFIG_CMD_ITEST is not set
# CONFIG_CMD_SOURCE is not set
# CONFIG_CMD_SETEXPR is not set
# CONFIG_CMD_NFS is not set
# CONFIG_CMD_MISC is not set
CONFIG_NET_RANDOM_ETHADDR=y
# CONFIG_DM_WARN is not set
# CONFIG_DM_DEVICE_REMOVE is not set
CONFIG_SPL_DM_SEQ_ALIAS=y
CONFIG_SFAX8_GPIO=y
CONFIG_SPI_FLASH_WINBOND=y
CONFIG_SPI_FLASH=y
CONFIG_NETDEVICES=y
CONFIG_SFA18_ETH=y
CONFIG_PINCTRL=y
CONFIG_SFAX8_PINCTRL=y
CONFIG_SFAX8_SERIAL=y
CONFIG_SFAX8_SPI=y
CONFIG_TIMER=y
CONFIG_SFAX8_TIMER=y
CONFIG_SFAX8_DDR2=y
# CONFIG_REGEX is not set
```

## uboot/configs/sfa18_mpw1_p10b_defconfig
```kconfig
CONFIG_MIPS=y
CONFIG_SYS_MALLOC_F_LEN=0x1000
CONFIG_DM_SPI=y
CONFIG_DM_SPI_FLASH=y
CONFIG_DM_GPIO=y
CONFIG_BLK=y
CONFIG_MACH_SFAX8=y
CONFIG_SOC_SFA18_MPW1=y
CONFIG_TARGET_SFA18_P10B=y
CONFIG_ETH_LED=y
CONFIG_SYS_MEM_SIZE=0x4000000
CONFIG_DEFAULT_DEVICE_TREE="sfa18_mpw1"
CONFIG_SYS_EXTRA_OPTIONS="SPI_BOOT"
CONFIG_HUSH_PARSER=y
CONFIG_SYS_PROMPT="sfa18 # "
# CONFIG_CMD_IMLS is not set
# CONFIG_CMD_LOADB is not set
# CONFIG_CMD_LOADS is not set
# CONFIG_CMD_FLASH is not set
CONFIG_CMD_MMC=y
CONFIG_CMD_SF=y
# CONFIG_CMD_FPGA is not set
# CONFIG_CMD_SETEXPR is not set
CONFIG_CMD_DHCP=y
# CONFIG_CMD_NFS is not set
CONFIG_CMD_PING=y
CONFIG_NET_RANDOM_ETHADDR=y
CONFIG_SPL_DM_SEQ_ALIAS=y
CONFIG_DMA=y
CONFIG_SFAX8_DMA=y
CONFIG_SFAX8_GPIO=y
CONFIG_DM_MMC=y
CONFIG_SFAX8_DW_MMC=y
CONFIG_SPI_FLASH_WINBOND=y
CONFIG_SPI_FLASH=y
CONFIG_NETDEVICES=y
CONFIG_SFA18_ETH=y
CONFIG_PINCTRL=y
CONFIG_SFAX8_PINCTRL=y
CONFIG_SFAX8_SERIAL=y
CONFIG_SFAX8_SPI=y
CONFIG_TIMER=y
CONFIG_SFAX8_TIMER=y
CONFIG_SFAX8_DDR2=y
```

## uboot/configs/sfa28_fullmask_ac28nand_defconfig
```kconfig
CONFIG_MIPS=y
CONFIG_SYS_MALLOC_F_LEN=0x1000
CONFIG_DM_SPI=y
CONFIG_DM_SPI_FLASH=y
CONFIG_DM_GPIO=y
CONFIG_BLK=y
CONFIG_MACH_SFAX8=y
CONFIG_SOC_SFA28_FULLMASK=y
CONFIG_TARGET_SFA28_AC28=y
CONFIG_BTN_HTTPD_PMU=y
CONFIG_SYS_MEM_SIZE=0x8000000
CONFIG_DEFAULT_DEVICE_TREE="sfa28_fullmask_nand"
CONFIG_SYS_EXTRA_OPTIONS="SPI_NAND_BOOT"
CONFIG_BOOTDELAY=2
CONFIG_HUSH_PARSER=y
CONFIG_SYS_PROMPT="sfa28 # "
# CONFIG_CMD_IMLS is not set
# CONFIG_CMD_LOADB is not set
# CONFIG_CMD_LOADS is not set
# CONFIG_CMD_FLASH is not set
CONFIG_CMD_SPI_NAND=y
# CONFIG_CMD_FPGA is not set
# CONFIG_CMD_SETEXPR is not set
CONFIG_CMD_DHCP=y
# CONFIG_CMD_NFS is not set
CONFIG_CMD_PING=y
CONFIG_NET_RANDOM_ETHADDR=y
CONFIG_SPL_DM_SEQ_ALIAS=y
CONFIG_DMA=y
CONFIG_SFAX8_DMA=y
CONFIG_SFAX8_GPIO=y
CONFIG_SPI_NAND=y
CONFIG_SPI_NAND_MACRONIX=y
CONFIG_SPI_NAND_MICRON=y
CONFIG_SPI_NAND_WINBOND=y
CONFIG_SPI_NAND_ICMAX=y
CONFIG_SPI_NAND_GIGADEVICE=y
CONFIG_SPI_NAND_TOSHIBA=y
CONFIG_NETDEVICES=y
CONFIG_SFA18_GMAC=y
CONFIG_SFA18_GMAC_TX_DELAY=0x40
CONFIG_SFA18_GMAC_RX_DELAY=0x20
CONFIG_SFA18_ESWITCH_RST_GPIO=0xb
CONFIG_PINCTRL=y
CONFIG_SFA28_PINCTRL=y
CONFIG_SFAX8_SERIAL=y
CONFIG_SFAX8_SPI=y
CONFIG_TIMER=y
CONFIG_SFAX8_TIMER=y
CONFIG_SFAX8_DDR3=y
```

## uboot/configs/sfa28_fullmask_hwa_defconfig
```kconfig
CONFIG_MIPS=y
CONFIG_SYS_MALLOC_F_LEN=0x1000
CONFIG_DM_SPI=y
CONFIG_DM_SPI_FLASH=y
CONFIG_DM_GPIO=y
CONFIG_BLK=y
CONFIG_MACH_SFAX8=y
CONFIG_SOC_SFA28_FULLMASK=y
CONFIG_TARGET_SFA28_P20B=y
CONFIG_BTN_HTTPD_PMU=y
CONFIG_SYS_MEM_SIZE=0x8000000
CONFIG_DEFAULT_DEVICE_TREE="sfa28_fullmask"
CONFIG_SYS_EXTRA_OPTIONS="SPI_BOOT"
CONFIG_BOOTDELAY=2
CONFIG_HUSH_PARSER=y
CONFIG_SYS_PROMPT="sfa28 # "
# CONFIG_CMD_IMLS is not set
# CONFIG_CMD_LOADB is not set
# CONFIG_CMD_LOADS is not set
# CONFIG_CMD_FLASH is not set
CONFIG_CMD_SF=y
# CONFIG_CMD_FPGA is not set
# CONFIG_CMD_SETEXPR is not set
CONFIG_CMD_DHCP=y
# CONFIG_CMD_NFS is not set
CONFIG_CMD_PING=y
CONFIG_NET_RANDOM_ETHADDR=y
CONFIG_SPL_DM_SEQ_ALIAS=y
CONFIG_DMA=y
CONFIG_SFAX8_DMA=y
CONFIG_SFAX8_GPIO=y
CONFIG_SPI_FLASH_WINBOND=y
CONFIG_SPI_FLASH=y
CONFIG_SPI_FLASH_GIGADEVICE=y
CONFIG_NETDEVICES=y
CONFIG_SFA18_GMAC=y
CONFIG_SFA18_GMAC_TX_DELAY=0x21
CONFIG_SFA18_GMAC_RX_DELAY=0x30
CONFIG_PINCTRL=y
CONFIG_SFA28_PINCTRL=y
CONFIG_SFAX8_SERIAL=y
CONFIG_SFAX8_SPI=y
CONFIG_TIMER=y
CONFIG_SFAX8_TIMER=y
CONFIG_SFAX8_DDR3=y
```

## uboot/drivers/ddr/siflower/Kconfig
```kconfig
#
# Siflower DDR infrastructure and drivers
#

menu "Siflower SFAX8 DDR Support"

config SFAX8_DDR2
	bool "Enable Siflower SFAX8 DDR2 drivers"
	depends on MACH_SFAX8
	help
	  Enable Siflower DDR2 drivers.

config SFAX8_DDR3
	bool "Enable Siflower SFAX8 DDR3 drivers"
	depends on MACH_SFAX8
	help
	  Enable Siflower DDR2 drivers.

endmenu
```

## uboot/drivers/mtd/spi-nand/Kconfig
```kconfig
menu "SPI NAND Device Support"

config SPI_NAND
	bool "Enable SPI NAND flash support"
	depends on DM && DM_SPI
	select SPI_FLASH
	select DM_SPI_FLASH
	help
	  This option, if enabled, provides support of SPI NAND flash.

config SPI_NAND_MICRON
	bool "Support Micron SPI NAND flash"
	depends on SPI_NAND
	help
	  Enable support for the Micron SPI NAND flash.

config SPI_NAND_ICMAX
	bool "Support ICMAX SPI NAND flash"
	depends on SPI_NAND
	help
	  Enable support for the ICMAX SPI NAND flash.

config SPI_NAND_WINBOND
	bool "Support WINBOND SPI NAND flash"
	depends on SPI_NAND
	help
	  Enable support for the WINBOND SPI NAND flash.

config SPI_NAND_ESMT
	bool "Support ESMT SPI NAND flash"
	depends on SPI_NAND
	help
	  Enable support for the ESMT SPI NAND flash.

config SPI_NAND_MACRONIX
	bool "Support MACRONIX SPI NAND flash"
	depends on SPI_NAND
	help
	  Enable support for the MACRONIX SPI NAND flash.

config SPI_NAND_TOSHIBA
	bool "Support TOSHIBA SPI NAND flash"
	depends on SPI_NAND
	help
	  Enable support for the TOSHIBA SPI NAND flash.

config SPI_NAND_FUDANMICRO
	bool "Support FUDANMICRO SPI NAND flash"
	depends on SPI_NAND
	help
	  Enable support for the FUDANMICRO SPI NAND flash.

config SPI_NAND_GIGADEVICE
	bool "Support GIGADEVICE SPI NAND flash"
	depends on SPI_NAND
	help
	  Enable support for the GIGADEVICE SPI NAND flash.

endmenu
```
